## dts/bindings/ethernet/st,stm32-ethernet.yaml
```yaml
# Copyright (c) 2020, Linaro Limited
# SPDX-License-Identifier: Apache-2.0

description: ST STM32 Ethernet

compatible: "st,stm32-ethernet"

include: [ethernet.yaml, pinctrl-device.yaml]

properties:
    reg:
      required: true
    interrupts:
      required: true
    clocks:
      required: true
    clock-names:
      required: true
    pinctrl-0:
      required: true
    pinctrl-names:
      required: true
    reset-gpios:
      type: phandle-array
      required: false
      description: Optional hardware reset line for PHY; used in lieu of soft reset if available
```
